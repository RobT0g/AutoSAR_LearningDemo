AUTOSAR XML (schema 00046)
package /Interfaces
  sender receiver interface I_Temperature
    data Temperature: implementation-data-type=float32
  client server interface I_StartMotor
    operation StartMotor: possible-error=[I_StartMotor/E_OK, I_StartMotor/E_NOK]
      arg FanSpeed: type=uint8, direction=IN
    error E_OK: error-code=0
    error E_NOK: error-code=1
  client server interface I_StopMotor
    operation StopMotor: possible-error=[I_StopMotor/E_OK, I_StopMotor/E_NOK]
    error E_OK: error-code=0
    error E_NOK: error-code=1

AUTOSAR XML (schema 00046)
package /Composition
  composition sw component type TempControlComposition
    component EcuAbstComp: type=TempHBridgeSWC
    component ApplicationSWC: type=TemControlSWC
    connect EcuAbstComp.P_Temperature -> ApplicationSWC.R_Temperature
    connect EcuAbstComp.P_StartMotor -> ApplicationSWC.R_StartMotor
    connect EcuAbstComp.P_StopMotor -> ApplicationSWC.R_StopMotor
